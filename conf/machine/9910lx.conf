## conf/machine/9910lx.conf
```bitbake
#
# This is config file for Protek 9910LX
#

SOC_FAMILY = "bcm7362"

require conf/machine/include/ceryon-mipsel.inc

PREFERRED_VERSION_linux-ceryon = "4.0.1"

MACHINE_ESSENTIAL_EXTRA_RDEPENDS += "\
    ceryon-dvb-modules-7220s \
    "

MACHINE_FEATURES += "textlcd ci 7segment RCA"
```

## conf/machine/9911lx.conf
```bitbake
#
# This is config file for Protek 9911LX
#

SOC_FAMILY = "bcm73625"

require conf/machine/include/ceryon-mipsel.inc

IMAGEDIR = "9911lx"

MACHINE_ESSENTIAL_EXTRA_RDEPENDS = "\
    ceryon-dvb-modules-7225s \
    "

MACHINE_FEATURES += "textlcd ci 7segment dvb-c"

DVBMEDIASINK_CONFIG += "--with-h265 --with-vb6 --with-vb8 --with-spark"
```

## conf/machine/9920lx.conf
```bitbake
#
# This is config file for Protek 9920LX
#

SOC_FAMILY = "bcm73625"

require conf/machine/include/ceryon-mipsel.inc

PREFERRED_VERSION_linux-ceryon= "4.10.12"

MACHINE_ESSENTIAL_EXTRA_RDEPENDS += "\
    ceryon-dvb-modules-7225s \
    "

MACHINE_FEATURES += "textlcd ci 7segment dvb-c"

DVBMEDIASINK_CONFIG += "--with-h265 --with-vb6 --with-vb8 --with-spark"
```

## conf/machine/e4hd.conf
```bitbake
#
# This is config file for AXAS E4HD
#

SOC_FAMILY = "bcm7362"

require conf/machine/include/ceryon-mipsel.inc

PREFERRED_VERSION_linux-ceryon= "4.10.12"

IMAGEDIR = "e4hd"

MACHINE_ESSENTIAL_EXTRA_RDEPENDS += "\
    ceryon-dvb-modules-e4hd \
    "
```

## conf/machine/e4hdcombo.conf
```bitbake
#
# This is config file for AXAS E4HD Combo
#

require conf/machine/include/7225s.inc

RCNAME = "e4hdcombo"

DISPLAY_BRAND = "AXAS"
DISPLAY_MODEL = "E4HD COMBO"
```

## conf/machine/e4hdhybrid.conf
```bitbake
#
# This is config file for AXAS E4HD Hybrid
#

require conf/machine/include/7000s.inc

IMAGEDIR = "e4hd"

MACHINE_FEATURES += "dvb-c"

DISPLAY_BRAND = "AXAS"
DISPLAY_MODEL = "E4HD HYBRID"
```

## conf/machine/e4hdultra.conf
```bitbake
#
# This is config file for AXAS E4HD Ultra 4K
#

SOC_FAMILY = "bcm7252s"

require conf/machine/include/ceryon-arm.inc

IMAGEDIR = "e4hd"

MACHINE_ESSENTIAL_EXTRA_RDEPENDS += "\
    ceryon-dvb-modules-e4hd \
    kernel-module-mt7601u \
    firmware-mt7601u \
    "
```

## conf/machine/include/7000s.inc
```bitbake
require conf/machine/include/ceryon-mipsel.inc

SOC_FAMILY = "bcm7362"

PREFERRED_VERSION_linux-ceryon = "4.0.1"

MACHINE_ESSENTIAL_EXTRA_RDEPENDS += "\
    ceryon-dvb-modules-7000s \
    "

MACHINE_FEATURES += "AV_JACK"

STB_PLATFORM = "7000s"
```

## conf/machine/include/7100s.inc
```bitbake
require conf/machine/include/ceryon-mipsel.inc

SOC_FAMILY = "bcm7362"

PREFERRED_VERSION_linux-ceryon = "4.0.1"

MACHINE_ESSENTIAL_EXTRA_RDEPENDS += "\
    ceryon-dvb-modules-7100s \
    "

MACHINE_EXTRA_RRECOMMENDS += "\
    ceryon-lcd \
    "

MACHINE_FEATURES += "colorlcd220 lcd220 ci RCA"

STB_PLATFORM = "7100s"
```

## conf/machine/include/7210s.inc
```bitbake
require conf/machine/include/ceryon-mipsel.inc

SOC_FAMILY = "bcm73625"

PREFERRED_VERSION_linux-ceryon= "4.10.12"

MACHINE_ESSENTIAL_EXTRA_RDEPENDS += "\
    ceryon-dvb-modules-7215s \
    "

MACHINE_EXTRA_RRECOMMENDS += "\
    ceryon-lcd \
    "

MACHINE_FEATURES += "colorlcd220 lcd220 ci RCA"

DVBMEDIASINK_CONFIG += "--with-h265 --with-vb6 --with-vb8 --with-spark"

STB_PLATFORM = "7210s"
```

## conf/machine/include/7225s.inc
```bitbake
require conf/machine/include/ceryon-mipsel.inc

SOC_FAMILY = "bcm73625"

PREFERRED_VERSION_linux-ceryon= "4.10.12"

MACHINE_ESSENTIAL_EXTRA_RDEPENDS += "\
    ceryon-dvb-modules-7225s \
    "

MACHINE_FEATURES += "textlcd ci 7segment dvb-c RCA"

DVBMEDIASINK_CONFIG += "--with-h265 --with-vb6 --with-vb8 --with-spark"

STB_PLATFORM = "7225s"
```

## conf/machine/include/ceryon-oem.inc
```bitbake
# We know about rtc
include conf/machine/include/build-extras.inc

MTD_KERNEL = "mtd1"
MTD_ROOTFS = "mtd2"

KERNEL_FILE = "kernel.bin"
ROOTFS_FILE = "rootfs.bin"

DVBPROVIDER = "kernel"
DVBSKYPROVIDER = "kernel"

MACHINE_ESSENTIAL_EXTRA_RRECOMMENDS = "\
    kernel-module-cdfs \
    "

MACHINE_EXTRA_RRECOMMENDS = " \
    ${@bb.utils.contains("GST_VERSION", "1.0", "gstreamer1.0-plugin-dvbmediasink", "gst-plugin-dvbmediasink", d)} \
    gstreamer1.0-libav \
    "

include conf/machine/include/autoload-filesystems.inc
require conf/machine/include/soc-family.inc

DVBMEDIASINK_CONFIG = "--with-wma --with-wmv --with-pcm --with-dts --with-eac3"

PREFERRED_PROVIDER_virtual/kernel = "linux-ceryon"

PREFERRED_PROVIDER_virtual/blindscan-dvbs = "ceryon-blindscan-utils"
PREFERRED_PROVIDER_virtual/blindscan-dvbc = "ceryon-blindscan-utils"

MACHINE_FEATURES += "3dtv alsa hdmicec switchoff videoenhancement skins1080 blindscan-tbs"

BOOTLOGO_FILENAME = "splash.bin"
```

## conf/machine/mbmicro.conf
```bitbake
#
# This is config file for Miraclebox Premium Micro
#

require conf/machine/include/7000s.inc

IMAGEDIR = "miraclebox/micro"

RCNAME = "miraclebox"

DISPLAY_BRAND = "Miraclebox"
DISPLAY_MODEL = "Premium Micro"
```

## conf/machine/mbmicrov2.conf
```bitbake
#
# This is config file for Miraclebox Premium Micro V2
#

SOC_FAMILY = "bcm73625"

require conf/machine/include/ceryon-mipsel.inc

PREFERRED_VERSION_linux-ceryon= "4.10.12"

IMAGEDIR = "miraclebox/microv2"

MACHINE_ESSENTIAL_EXTRA_RDEPENDS += "\
    ceryon-dvb-modules-7005s \
    "

DVBMEDIASINK_CONFIG += "--with-h265 --with-vb6 --with-vb8 --with-spark"

MACHINE_FEATURES += "AV_JACK"
```

## conf/machine/odin2hybrid.conf
```bitbake
#
# This is config file for Opticum Odin2 Hybrid
#

SOC_FAMILY = "bcm7362"

require conf/machine/include/ceryon-mipsel.inc

PREFERRED_VERSION_linux-ceryon = "4.0.1"

IMAGEDIR = "odin2/hybrid"

MACHINE_ESSENTIAL_EXTRA_RDEPENDS += "\
    ceryon-dvb-modules-7300s \
    "

MACHINE_FEATURES += "textlcd ci 7segment dvb-c RCA"
```

## conf/machine/odinplus.conf
```bitbake
#
# This is config file for Opticum Odin2 Plus
#

SOC_FAMILY = "bcm7362"

require conf/machine/include/ceryon-mipsel.inc

PREFERRED_VERSION_linux-ceryon = "4.0.1"

MACHINE_ESSENTIAL_EXTRA_RDEPENDS += "\
    ceryon-dvb-modules-7400s \
    "

MACHINE_FEATURES += "textlcd ci 7segment"
```

## conf/machine/protek4k.conf
```bitbake
#
# This is config file for Protek 4K
#

require conf/machine/include/ceryon-arm.inc

RCTYPE = "26"
RCNAME = "protek2"

DISPLAY_BRAND = "PROTEK"
DISPLAY_MODEL = "4K UHD"
```

## conf/machine/sf208.conf
```bitbake
#
# This is config file for Octagon SF208 HD LCD Single
#

require conf/machine/include/7210s.inc

RCNAME = "sf2x8"

DISPLAY_BRAND = "OCTAGON"
DISPLAY_MODEL = "SF208 E2 HD LCD SINGLE"
```

## conf/machine/sf228.conf
```bitbake
#
# This is config file for Octagon SF228 HD LCD Twin
#

require conf/machine/include/7210s.inc

RCNAME = "sf2x8"

DISPLAY_BRAND = "OCTAGON"
DISPLAY_MODEL = "SF228 E2 HD LCD TWIN"
```

## conf/machine/sf238.conf
```bitbake
#
# This is config file for Octagon SF238 HD LCD Twin
#

KERNELVERSION = "4.10.12"

SOC_FAMILY = "bcm73625"

require conf/machine/include/ceryon-mipsel.inc

PREFERRED_VERSION_linux-ceryon= "${KERNELVERSION}"

MACHINE_ESSENTIAL_EXTRA_RDEPENDS += "\
	ceryon-dvb-modules-7215s \
	"

MACHINE_EXTRA_RRECOMMENDS += "\
	ceryon-lcd \
	"

MACHINE_FEATURES += "colorlcd220 lcd220 ci RCA"

DVBMEDIASINK_CONFIG += "--with-h265 --with-vb6 --with-vb8 --with-spark"

RCNAME = "sf2x8"
```

## conf/machine/singleboxlcd.conf
```bitbake
#
# This is config file for Red Eagle Singlebox LCD
#

require conf/machine/include/7100s.inc

IMAGEDIR = "redeagle/singleboxlcd"

RCNAME = "red2"

DISPLAY_BRAND = "RED EAGLE"
DISPLAY_MODEL = "SINGLEBOX LCD"
```

## conf/machine/twinboxlcd.conf
```bitbake
#
# This is config file for Red Eagle Twinbox LCD
#

require conf/machine/include/7100s.inc

IMAGEDIR = "redeagle/twinboxlcd"

RCNAME = "red1"

DISPLAY_BRAND = "RED EAGLE"
DISPLAY_MODEL = "TWINBOX LCD"
```

## conf/machine/twinboxlcdci5.conf
```bitbake
#
# This is config file for Red Eagle Twinbox LCD CI
#

KERNELVERSION = "4.10.12"

SOC_FAMILY = "bcm73625"

require conf/machine/include/ceryon-mipsel.inc

PREFERRED_VERSION_linux-ceryon= "${KERNELVERSION}"

IMAGEDIR = "redeagle/twinboxlcd"

MACHINE_ESSENTIAL_EXTRA_RDEPENDS += "\
	ceryon-dvb-modules-7105s \
	"

MACHINE_EXTRA_RRECOMMENDS += "\
	ceryon-lcd \
	"

MACHINE_FEATURES += "colorlcd220 lcd220 ci RCA"

DVBMEDIASINK_CONFIG += "--with-h265 --with-vb6 --with-vb8 --with-spark"
```
